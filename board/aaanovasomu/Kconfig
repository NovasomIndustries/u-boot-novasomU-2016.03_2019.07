## board/aaanovasomu/Kconfig
```kconfig
if TARGET_NOVASOMU

config SYS_BOARD
	default "novasomu"

config SYS_SOC
	default "mx6"

config SYS_CONFIG_NAME
	default "novasomu"

endif
```

## board/novasis/novasomp/Kconfig
```kconfig
if TARGET_NOVASOMP

config SYS_BOARD
	default "novasomp"

config SYS_VENDOR
       default "novasis"

config SYS_CONFIG_NAME
	default "novasomp"

endif
```

## board/novasis/novasoms/Kconfig
```kconfig
if TARGET_NOVASOMS

config SYS_BOARD
	default "novasoms"

config SYS_SOC
	default "mx6"

config SYS_CONFIG_NAME
	default "novasoms"

endif
```

## board/novasis/novasomu/Kconfig
```kconfig
if TARGET_NOVASOMU

config SYS_BOARD
       default "novasomu"

config SYS_VENDOR
       default "novasis"

config SYS_CONFIG_NAME
       default "novasomu"

endif
```

## configs/novasomu_defconfig
```kconfig
CONFIG_SYS_EXTRA_OPTIONS="IMX_CONFIG=board/novasis/novasomu/imximage.cfg"
CONFIG_BOARDDIR="novasis/"
CONFIG_ARM=y
CONFIG_ARCH_MX6=y
CONFIG_TARGET_NOVASOMU=y
CONFIG_CMD_GPIO=y
```
